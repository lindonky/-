## firmware/components/bsp/Kconfig.projbuild
```kconfig
menu "BSP (Board Support)"

    config ESC_MOTOR_GPIO_1
        int "ESC 1 signal GPIO"
        default 15
        help
            Yellow signal wire of ESC 1.

    config ESC_MOTOR_GPIO_2
        int "ESC 2 signal GPIO"
        default 16
        help
            Yellow signal wire of ESC 2.

    config ESC_MOTOR_GPIO_3
        int "ESC 3 signal GPIO"
        default 14
        help
            Yellow signal wire of ESC 3.

    config ESC_CONSOLE_BAUD
        int "Console UART baud rate"
        default 115200
        help
            Baud rate of the on-board CH340 serial (UART0, GPIO43/44).

    config ESC_BT_NAME
        string "Bluetooth (BLE) device name"
        default "AlwaysbeA"
        help
            BLE advertising name shown when scanning from a phone.

    config ESC_IMU_UART_RX_GPIO
        int "JY61P UART RX GPIO (JY61P TX wire)"
        default 6
        help
            JY61P sends attitude data on this pin (UART2 RX).

    config ESC_IMU_UART_TX_GPIO
        int "JY61P UART TX GPIO (optional, for readback)"
        default 5
        help
            UART2 TX, only needed if you want to read back JY61P config.

    config ESC_IMU_UART_BAUD
        int "JY61P UART baud rate"
        default 9600
        help
            JY61P 出厂多为 115200，但不少模块被设成 9600；以实测为准
            （STAB 查询里 rx 有字节但 frames=0 即为波特率不匹配）。

endmenu
```

## firmware/components/comm/Kconfig.projbuild
```kconfig
menu "Comm (Transports)"

    config ESC_AP_SSID
        string "WiFi AP SSID"
        default "AlwaysbeA"
        help
            Phone connects to this WiFi hotspot, then opens 192.168.4.1.

    config ESC_AP_PASSWORD
        string "WiFi AP password (empty = open)"
        default "12345678"
        help
            Leave empty for an open hotspot.

endmenu
```

## firmware/components/control/Kconfig.projbuild
```kconfig
menu "ESC Control"

    config ESC_CALIBRATE_ON_BOOT
        bool "Run ESC calibration sequence on boot"
        default y
        help
            On boot all channels hold 2200us for CAL_HIGH_TIME then the stop
            pulse for CAL_STOP_TIME, so the ESCs arm and beep. Disable after
            the ESCs are calibrated.

    config ESC_CALIB_HIGH_TIME_MS
        int "Calibration high pulse hold time (ms)"
        default 3000
        range 3000 10000

    config ESC_CALIB_STOP_TIME_MS
        int "Calibration stop pulse hold time (ms)"
        default 3000
        range 3000 10000

    config ESC_STOP_PULSE_US
        int "Stop pulse width (us)"
        default 1500
        range 800 2200
        help
            Center / stop pulse. 1500us for most ESCs; if arming fails try 1480us.

    config ESC_RAMP_STEP_US
        int "Speed ramp step (us per step)"
        default 50
        range 10 200
        help
            PWM is changed in small steps toward the target so the motor never
            jumps across the center instantly (protects the ESC when reversing).

    config ESC_RAMP_INTERVAL_MS
        int "Speed ramp step interval (ms)"
        default 100
        range 10 1000

    config ESC_BIDIRECTIONAL
        bool "Allow reverse (bidirectional ESCs)"
        default n
        help
            Enable when the ESCs are successfully initialized in bidirectional
            mode (negative speed = reverse). NOTE: the current ESC hardware only
            runs forward (reverse calibration does not take), so negative
            speeds are clamped to 0 while this is disabled.

    config STAB_ENABLE_ON_BOOT
        bool "Enable attitude stabilization on boot"
        default n

    config STAB_PERIOD_MS
        int "Stabilization control loop period (ms)"
        default 10
        range 5 50

    config STAB_STALE_TIMEOUT_MS
        int "IMU data stale timeout (ms)"
        default 200
        range 50 1000
        help
            Stop output if no valid JY61P frame within this time.

    config STAB_KP
        int "Angle error gain (output per degree)"
        default 20
        range 1 100

    config STAB_KD
        int "Gyro damping gain"
        default 5
        range 0 50

    config STAB_DEADBAND_DEG
        int "Deadband (deg): leg rests inside this range"
        default 3
        range 0 30

    config STAB_MAX_ANGLE_DEG
        int "Max deviation (deg): stop output beyond this"
        default 30
        range 5 90

    config STAB_MAX_OUTPUT
        int "Max control output (0-1000)"
        default 800
        range 100 1000

    config MODE_ASSIST_MAX
        int "Assist mode max output (0-1000)"
        default 800
        range 100 1000
        help
            Assist (support) mode: attitude stabilization output upper limit.

    config MODE_ACTIVE_MAX
        int "Active mode max output (0-1000)"
        default 1000
        range 100 1000
        help
            Active mode left/right correction output upper limit. The middle
            propulsion thruster always remains neutral in active mode.

    config MODE_IMPEDANCE_MAX
        int "Impedance mode max output (0-1000)"
        default 600
        range 100 1000
        help
            Impedance mode: reverses propulsion when the leg lifts
            (requires bidirectional ESCs; single-direction ESCs just slow
            to a stop). Output upper limit for both reverse and rudders.

    menu "Single-leg training metrics (engineering defaults)"

        config TRAIN_LIFT_START_DEG
            int "Lift detection threshold (shank deg)"
            default 8
            range 3 30

        config TRAIN_ROM_MIN_DEG
            int "Qualified shank ROM minimum (deg)"
            default 15
            range 5 60

        config TRAIN_ROM_MAX_DEG
            int "Qualified shank ROM maximum (deg)"
            default 45
            range 10 80

        config TRAIN_ROM_LIMIT_DEG
            int "Reject cycle beyond shank ROM (deg)"
            default 60
            range 20 90

        config TRAIN_SPEED_MIN_DPS
            int "Qualified mean angular speed minimum (deg/s)"
            default 10
            range 1 100

        config TRAIN_SPEED_MAX_DPS
            int "Qualified mean angular speed maximum (deg/s)"
            default 90
            range 20 300

        config TRAIN_CYCLE_MIN_MS
            int "Qualified cycle minimum time (ms)"
            default 800
            range 300 5000

        config TRAIN_CYCLE_MAX_MS
            int "Cycle timeout / qualified maximum time (ms)"
            default 8000
            range 2000 30000

        config TRAIN_LATERAL_MAX_DEG
            int "Qualified lateral shank deviation maximum (deg)"
            default 8
            range 2 30

        config TRAIN_RETURN_WINDOW_DEG
            int "Return-to-neutral window (deg)"
            default 5
            range 2 15

        config TRAIN_FALL_ANGLE_DEG
            int "Fall angle threshold relative to session start (deg)"
            default 65
            range 35 85
            help
                Latch emergency stop when either relative pitch or roll stays
                beyond this angle for TRAIN_FALL_ANGLE_HOLD_MS. This threshold
                must remain above TRAIN_ROM_LIMIT_DEG or the build will fail.

        config TRAIN_FALL_ANGLE_HOLD_MS
            int "Fall angle confirmation time (ms)"
            default 400
            range 100 2000

        config TRAIN_FALL_ACCEL_LOW_MG
            int "Free-fall acceleration threshold (milli-g)"
            default 550
            range 100 900
            help
                A resultant acceleration at or below this value immediately
                latches emergency stop while a training session is running.

        config TRAIN_FALL_ACCEL_HIGH_MG
            int "Impact acceleration threshold (milli-g)"
            default 1600
            range 1100 4000
            help
                A resultant acceleration at or above this value immediately
                latches emergency stop while a training session is running.

    endmenu

    config CAPTURE_MAX_SAMPLES
        int "Calibration capture sample capacity"
        default 1200
        range 200 3000
        help
            Number of valid IMU samples kept in RAM for a temporary calibration
            capture. At the usual JY61P UART output rate this is tens of seconds.
            Captures are never written to flash and are lost on reboot.

    config STAB_SWAP_PITCH_ROLL
        bool "Swap pitch/roll (JY61P mounted rotated 90 deg)"
        default n
        help
            Select when the JY61P is mounted 90 degrees rotated on the leg:
            pitch/roll measurement and gyro are exchanged before control.

    config STAB_PITCH_SIGN
        int "Pitch output sign (+1/-1)"
        default 1
        range -1 1
        help
            Flip to -1 if the leg pitches the wrong way under stabilization
            (forward/back direction reversed).

    config STAB_ROLL_SIGN
        int "Roll output sign (+1/-1)"
        default 1
        range -1 1
        help
            Flip to -1 if the leg rolls the wrong way under stabilization
            (left/right direction reversed).

endmenu
```

## firmware/sdkconfig.defaults
```kconfig
# ESP32-S3 三路电调控制工程
CONFIG_IDF_TARGET="esp32s3"
# 电调已校准后关闭上电自动校准：避免 2200us 校准脉冲让已武装的电调误判为满油门狂转。
# 需要重新校准（换电调/换电池）时用网页或串口发送 CAL。
CONFIG_ESC_CALIBRATE_ON_BOOT=n

# 双向脉宽支持：阻抗模式"抬脚时推进反转"需要向推进发 <1500us 的反转脉宽。
# 注意：当前电调实测不支持物理反转（只会减速到停），换支持反转的电调后即生效。
CONFIG_ESC_BIDIRECTIONAL=y

# 三模式输出上限（PWM 幅值）：助力=80% / 主动=100%(基准50%) / 阻抗=60%
CONFIG_MODE_ASSIST_MAX=800
CONFIG_MODE_ACTIVE_MAX=1000
CONFIG_MODE_IMPEDANCE_MAX=600
CONFIG_TRAIN_LIFT_START_DEG=8
CONFIG_TRAIN_ROM_MIN_DEG=15
CONFIG_TRAIN_ROM_MAX_DEG=45
CONFIG_TRAIN_ROM_LIMIT_DEG=60
CONFIG_TRAIN_SPEED_MIN_DPS=10
CONFIG_TRAIN_SPEED_MAX_DPS=90
CONFIG_TRAIN_CYCLE_MIN_MS=800
CONFIG_TRAIN_CYCLE_MAX_MS=8000
CONFIG_TRAIN_LATERAL_MAX_DEG=8
CONFIG_TRAIN_RETURN_WINDOW_DEG=5
CONFIG_TRAIN_FALL_ANGLE_DEG=65
CONFIG_TRAIN_FALL_ANGLE_HOLD_MS=400
CONFIG_TRAIN_FALL_ACCEL_LOW_MG=550
CONFIG_TRAIN_FALL_ACCEL_HIGH_MG=1600

# 蓝牙 BLE UART（Nordic UART Service；ESP32-S3 无经典蓝牙，仅 BLE）
CONFIG_BT_ENABLED=y
CONFIG_BT_BLUEDROID_ENABLED=y
CONFIG_BT_BLE_ENABLED=y
CONFIG_BT_BLE_50_FEATURES_SUPPORTED=n
CONFIG_BT_ALLOCATION_FROM_SPIRAM_FIRST=y
CONFIG_ESP_WIFI_ENABLED=y

# 自定义分区表（app 4MB）+ 16MB flash（板载 boya 16MB）
CONFIG_PARTITION_TABLE_CUSTOM=y
CONFIG_PARTITION_TABLE_CUSTOM_FILENAME="partitions.csv"
CONFIG_ESPTOOLPY_FLASHSIZE_16MB=y

# HTTP 请求头缓冲：默认 512B，手机 WebView/浏览器的请求头（UA+Accept+Sec-Fetch 等）
# 会超过 512B 导致 ESP32 返回 "Header fields are too long"。加大到 2048B。
CONFIG_HTTPD_MAX_REQ_HDR_LEN=2048
```
